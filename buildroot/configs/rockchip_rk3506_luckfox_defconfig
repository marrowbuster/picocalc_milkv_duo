## buildroot/configs/rockchip_rk3506_luckfox_defconfig
```kconfig
#include "base/base.config"
#include "fs/vfat.config"
#include "multimedia/audio.config"
#include "lvgl/lvgl_rkadk.config"
#include "fs/ubifs.config"
BR2_GENERATE_LOCALE="en_US.UTF-8"
BR2_PACKAGE_CAN_UTILS=y
BR2_PACKAGE_DIRECTFB=y
BR2_PACKAGE_DNSMASQ=y
BR2_PACKAGE_DOOM_WAD=y
BR2_PACKAGE_EVTEST=y
BR2_PACKAGE_FBSET=y
BR2_PACKAGE_FBTERM=y
BR2_PACKAGE_HOSTAPD=y
BR2_PACKAGE_HOST_LINUX_HEADERS_CUSTOM_6_1=y
BR2_PACKAGE_HTPDATE=y
BR2_PACKAGE_IPERF3=y
BR2_PACKAGE_IPROUTE2=y
BR2_PACKAGE_LIBCAP=y
BR2_PACKAGE_LIBCURL=y
BR2_PACKAGE_LIBEVDEV=y
BR2_PACKAGE_LIBJPEG=y
BR2_PACKAGE_LIBOPENSSL_BIN=y
BR2_PACKAGE_LIBRETRO_BSNES=y
BR2_PACKAGE_LIBRETRO_BSNES_BALANCED=y
BR2_PACKAGE_LIBRETRO_FCEUNEXT=y
BR2_PACKAGE_LIBRETRO_GEARBOY=y
BR2_PACKAGE_LIBRETRO_MGBA=y
BR2_PACKAGE_LRZSZ=y
BR2_PACKAGE_LUA=y
# BR2_PACKAGE_LVGL is reset to default
BR2_PACKAGE_LYNX=y
BR2_PACKAGE_MHZ=y
BR2_PACKAGE_MINICOM=y
BR2_PACKAGE_NANO=y
BR2_PACKAGE_NCFTP=y
BR2_PACKAGE_NET_TOOLS=y
BR2_PACKAGE_NTP=y
BR2_PACKAGE_NTP_NTPDATE=y
BR2_PACKAGE_OPENSSH=y
BR2_PACKAGE_OPENSSH_GEN_KEYS=y
BR2_PACKAGE_PHYTOOL=y
BR2_PACKAGE_PPPD=y
BR2_PACKAGE_PRBOOM=y
BR2_PACKAGE_PROCPS_NG=y
# BR2_PACKAGE_PULSEAUDIO is reset to default
BR2_PACKAGE_PYTHON3=y
BR2_PACKAGE_PYTHON3_SSL=y
BR2_PACKAGE_PYTHON_AIOHTTP=y
BR2_PACKAGE_PYTHON_CANOPEN=y
BR2_PACKAGE_PYTHON_CLICK=y
BR2_PACKAGE_PYTHON_ITSDANGEROUS=y
BR2_PACKAGE_PYTHON_JINJA2=y
BR2_PACKAGE_PYTHON_PERIPHERY=y
BR2_PACKAGE_PYTHON_PILLOW=y
BR2_PACKAGE_PYTHON_SERIAL=y
BR2_PACKAGE_PYTHON_SETUPTOOLS=y
BR2_PACKAGE_PYTHON_SMBUS_CFFI=y
BR2_PACKAGE_PYTHON_SPIDEV=y
BR2_PACKAGE_PYTHON_WERKZEUG=y
BR2_PACKAGE_RETROARCH=y
BR2_PACKAGE_RIPGREP=y
BR2_PACKAGE_RK3506=y
BR2_PACKAGE_RKADK=y
BR2_PACKAGE_RKADK_DISPLAY=y
BR2_PACKAGE_RKADK_EXAMPLES=y
BR2_PACKAGE_RKADK_PLAYER=y
BR2_PACKAGE_RKWIFIBT_APP=y
BR2_PACKAGE_ROCKCHIP_RGA=y
BR2_PACKAGE_ROCKCHIP_TEST=y
BR2_PACKAGE_SDL2=y
BR2_PACKAGE_SDL2_DIRECTFB=y
BR2_PACKAGE_SDL2_MIXER=y
BR2_PACKAGE_SDL2_NET=y
BR2_PACKAGE_SDL_DIRECTFB=y
BR2_PACKAGE_TMUX=y
BR2_PACKAGE_UTIL_LINUX_AGETTY=y
BR2_PACKAGE_VIM=y
BR2_PACKAGE_WGET=y
# BR2_PREFER_ROCKCHIP_RGA is not set
BR2_ROCKCHIP_ALSA_CONFIG_INSTALL_INIT_SCRIPT=y
BR2_ROOTFS_OVERLAY+="board/rockchip/rk3506/fast-display-overlay/ board/rockchip/rk3506/luckfox-overlay/ board/rockchip/rk3506/picocalc-overlay/"
BR2_ROOTFS_POST_BUILD_SCRIPT+="board/rockchip/rk3506/post-build-fast-display.sh"
BR2_ROOTFS_PRE_BUILD_SCRIPT="board/rockchip/rk3506/build-picocalc-driver.sh"
BR2_SYSTEM_ENABLE_NLS=y
BR2_TARGET_GENERIC_HOSTNAME="luckfox"
BR2_TARGET_GENERIC_ISSUE="Welcome to Luckfox Lyra [root:luckfox]"
# BR2_TARGET_GENERIC_REMOUNT_ROOTFS_RW is not set
BR2_TARGET_GENERIC_ROOT_PASSWD="luckfox"
BR2_TARGET_ROOTFS_SQUASHFS4_ZSTD=y
BR2_TARGET_SERIAL_SHELL_GETTY=y
BR2_TIME_BITS_64=y
BR2_arm=y
BR2_cortex_a7=y
```
